## Documentation/devicetree/bindings/clock/hisilicon.txt
```
Device Tree Clock bindings for arch-hi3xxx

This binding uses the common clock binding[1].

[1] Documentation/devicetree/bindings/clock/clock-bindings.txt

Required properties for mux clocks:
 - compatible : Shall be "hisilicon,hi3620-clk-mux".
 - clocks : shall be the input parent clock phandle for the clock. This should
	be the reference clock.
 - clock-output-names : shall be reference name.
 - #clock-cells : from common clock binding; shall be set to 0.
 - hisilicon,hi3620-mux : array of mux register offset & mask bits

Required properties for Hi3620 gate clocks:
 - compatible : Shall be "hisilicon,hi3620-clk-gate".
 - clocks : shall be the input parent clock phandle for the clock. This should
	be the reference clock.
 - clock-output-names : shall be reference name.
 - #clock-cells : from common clock binding; shall be set to 0.
 - hisilicon,hi3620-clkgate : array of enable register offset & enable bits
 - hisilicon,hi3620-clkreset : array of reset register offset & enable bits

Required properties for clock divider:
 - compatible : Shall be "hisilicon,hi3620-clk-div".
 - clocks : shall be the input parent clock phandle for the clock. This should
	be the reference clock.
 - clock-output-names : shall be reference name.
 - #clock-cells : from common clock binding; shall be set to 0.
 - #hisilicon,clkdiv-table-cells : the number of parameters after phandle in
   hisilicon,clkdiv-table property.
 - hisilicon,clkdiv-table : list of value that are used to configure clock
   divider. They're value of phandle, index & divider value.
 - hisilicon,clkdiv : array of divider register offset & mask bits.

Required properties for gate clocks:
 - compatible : Shall be "hisilicon,clk-gate".
 - clocks : shall be the input parent clock phandle for the clock. This should
	be the reference clock.
 - clock-output-names : shall be reference name.
 - #clock-cells : from common clock binding; shall be set to 0.
 - hisilicon,clkgate-inverted : bool value. True means that set-to-disable.

Required properties for clock fixed factor divider:
 - compatible : Shall be "hisilicon,fixed-factor".
 - clocks : shall be the input parent clock phandle for the clock. This should
	be the reference clock.
 - clock-output-names : shall be reference name.
 - #clock-cells : from common clock binding; shall be set to 0.
 - hisilicon,fixed-factor : array of multiplier & divider.

For example:
	timclk1: clkgate@38 {
		compatible = "hisilicon,clk-gate";
		#clock-cells = <0>;
		clocks = <&refclk_timer1>;
		clock-output-names = "timclk1";
		hisilicon,clkgate-inverted;
		hisilicon,clkgate = <0 18>;
	};

	dtable: clkdiv@0 {
		#hisilicon,clkdiv-table-cells = <2>;
	};

	div_cfgaxi: clkdiv@2 {
		compatible = "hisilicon,hi3620-clk-div";
		#clock-cells = <0>;
		clocks = <&div_shareaxi>;
		clock-output-names = "cfgAXI_div";
		hisilicon,clkdiv-table = <&dtable 0x01 2>;
		hisilicon,clkdiv = <0x100 0x60>;
	};
```

## arch/arm/mach-hi3xxx/Kconfig
```kconfig
config ARCH_HI3xxx
	bool "Hisilicon Hi36xx/Hi37xx family" if ARCH_MULTI_V7
	select ARM_AMBA
	select ARM_GIC
	select CACHE_L2X0
	select CACHE_PL310
	select CLKSRC_OF
	select PINCTRL
	select PINCTRL_SINGLE
	select SERIAL_AMBA_PL011
	select SERIAL_AMBA_PL011_CONSOLE
	help
	  Support for Hisilicon Hi36xx/Hi37xx processor family
```
